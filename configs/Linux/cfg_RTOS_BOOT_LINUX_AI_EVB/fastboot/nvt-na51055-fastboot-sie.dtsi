&fastboot {
	sie1_ctrl {
		out0_sz = <0>;
		out1_sz = <0x2800>;
		out2_sz = <0x1080>;
		out_dest = <0>;
		ring_buf_en = <0>;
		ring_buf_sz = <0x0>;
	};

	sie1_clk {
		clk_src = <7>;
		clk_rate = <300000000>;
		mclk_en = <0>;
		mclk_id = <1>;
		mclk_src = <0>;
		mclk_rate = <0>;
		pxclk_src = <1>;
	};

	sie1_reg {
		reg_num = <181>;
		reg_start = <0x0 0x1>,
		<0xc 0xffffffff>,
		<0x8 0x20000>,
		<0xc 0xffffffff>,
		<0x0 0x1>,
		<0xa4 0x0>,
		<0x0 0x3>,
		<0x0 0xc0000023>,
		<0x0 0x23>,
		<0x8 0x20089>,
		<0x0 0x23>,
		<0x0 0x23>,
		<0x4 0x0>,
		<0x0 0x23>,
		<0x4 0x0>,
		<0x0 0x23>,
		<0x28 0x8000c>,
		<0x2c 0x4380780>,
		<0x30 0x0>,
		<0x0 0x23>,
		<0x30 0x0>,
		<0x34 0x0>,
		<0x38 0x0>,
		<0x0 0x23>,
		<0x30 0x0>,
		<0x34 0x0>,
		<0x38 0x0>,
		<0x0 0x23>,
		<0x0 0x23>,
		<0x0 0x23>,
		<0xac 0x0>,
		<0x0 0x23>,
		<0x4 0x0>,
		<0x0 0x23>,
		<0x0 0x23>,
		<0x5c 0x400000>,
		<0x60 0x20000>,
		<0x64 0x0>,
		<0x0 0x23>,
		<0x4 0x0>,
		<0x0 0x23>,
		<0x28 0x8000c>,
		<0x2c 0x4380780>,
		<0x30 0x0>,
		<0x0 0x23>,
		<0x30 0x0>,
		<0x34 0x0>,
		<0x38 0x4380780>,
		<0x0 0x23>,
		<0x30 0x0>,
		<0x34 0x0>,
		<0x38 0x4380780>,
		<0x0 0x23>,
		<0x0 0x23>,
		<0x0 0x23>,
		<0x5c 0x400000>,
		<0x60 0x20b40>,
		<0x64 0x0>,
		<0x0 0x23>,
		<0x24 0x6c>,
		<0x0 0x23>,
		<0x8 0x20089>,
		<0x0 0x23>,
		<0x4 0x0>,
		<0x0 0x23>,
		<0x4 0x0>,
		<0x0 0x23>,
		<0xac 0x0>,
		<0x0 0x23>,
		<0x60 0x20b40>,
		<0x6c 0x0>,
		<0x0 0x23>,
		<0x0 0x23>,
		<0x4 0x0>,
		<0x0 0x23>,
		<0x4 0x0>,
		<0x0 0x23>,
		<0x5c 0x400000>,
		<0x60 0x20b40>,
		<0x64 0x0>,
		<0x0 0x23>,
		<0x4 0x0>,
		<0x0 0x23>,
		<0x24 0x6c>,
		<0x0 0x23>,
		<0x8 0x20089>,
		<0x0 0x23>,
		<0x4 0x0>,
		<0x0 0x23>,
		<0x68 0x128020c0>,
		<0x6c 0x0>,
		<0x70 0x0>,
		<0x74 0x128048c0>,
		<0x78 0x0>,
		<0x7c 0x0>,
		<0x0 0x23>,
		<0xa4 0x70000000>,
		<0x0 0x23>,
		<0x4 0x0>,
		<0x0 0x23>,
		<0x1b4 0x800080>,
		<0x1b8 0x800080>,
		<0x1bc 0x10080>,
		<0x0 0x23>,
		<0x1e8 0x104c>,
		<0x350 0x0>,
		<0x0 0x23>,
		<0x220 0x0>,
		<0x228 0x4380780>,
		<0x30 0x0>,
		<0x224 0x8740c06>,
		<0x23c 0x80a>,
		<0x240 0x1f1f>,
		<0x248 0x0>,
		<0x24c 0x1000140>,
		<0x2ac 0x80a>,
		<0x2b0 0x1f1f>,
		<0x0 0x23>,
		<0x22c 0xfff0000>,
		<0x230 0xfff0000>,
		<0x234 0xfff0000>,
		<0x238 0xfff0000>,
		<0x0 0x23>,
		<0x244 0x0>,
		<0x0 0x23>,
		<0x2a8 0xf0000>,
		<0x0 0x23>,
		<0x1ec 0x800080>,
		<0x1f0 0x80>,
		<0x0 0x23>,
		<0x250 0x8b12400>,
		<0x254 0x1113c4c6>,
		<0x258 0x16853530>,
		<0x25c 0x1b166d82>,
		<0x260 0x1ed76dc7>,
		<0x264 0x21b835fe>,
		<0x268 0x2448da29>,
		<0x26c 0x26d97e52>,
		<0x270 0x293a1e7a>,
		<0x274 0x2b9ab2a0>,
		<0x278 0x2ddb46c5>,
		<0x27c 0x2ffbd2e8>,
		<0x280 0x31dc4f09>,
		<0x284 0x33acc326>,
		<0x288 0x356d3743>,
		<0x28c 0x372da35f>,
		<0x290 0x38ce137b>,
		<0x294 0x3a6e7b95>,
		<0x298 0x3bfedfaf>,
		<0x29c 0x3d8f43c8>,
		<0x2a0 0x3effa3e0>,
		<0x2a4 0xffff7>,
		<0x0 0x23>,
		<0x1f4 0x0>,
		<0x0 0x23>,
		<0x2a8 0xf0000>,
		<0x0 0x23>,
		<0x50 0x10048914>,
		<0x0 0x23>,
		<0x154 0x80010>,
		<0x158 0xf2f0889>,
		<0x0 0x23>,
		<0xbc 0xf0>,
		<0x0 0x23>,
		<0xb4 0x0>,
		<0xb8 0x0>,
		<0xbc 0xf0>,
		<0xc0 0x0>,
		<0x0 0x23>,
		<0x1e8 0x104c>,
		<0x350 0x0>,
		<0x0 0x23>,
		<0x4 0x1a08220>,
		<0x0 0x23>,
		<0x0 0x24023>,
		<0x0 0x24023>,
		<0xa8 0x850000>,
		<0xc 0xffffffff>,
		<0x0 0x24022>,
		<0x0 0x24026>,
		<0x0 0x24026>;
	};

};
