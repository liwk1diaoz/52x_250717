&fastboot {
	venc {
		codectype = <0>;
		framerate = <15>;
		sec = <5>;
		yuv_one_src = <1>;
		jpeg_en = <0>;
		jpeg_quality = <50>;
		jpeg_fps = <5>;
		sub_en = <0>;
		sub_codectype = <0>;
		main_gop = <15>;
		sub_gop = <0>;
		main_qp = <26>;
		sub_qp = <0>;
	};
};