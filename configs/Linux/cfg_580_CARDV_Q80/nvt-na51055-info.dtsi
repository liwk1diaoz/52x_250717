/*
/*
 * Novatek Ltd. NA51055 BSP part of dts
 *
 * Cortex-A9
 *
 */

/ {
	nvt_info {						/* Get from ModelConfig.txt */
		BIN_NAME = "FW96580A";//"FW96580A";
		BIN_NAME_T = "FW96580T";//"FW96580T";
		RTOS_APP_MAIN = "cardv"; /* Optional, if OS type is Linux, dont care it. */
		/* EMBMEM_BLK_SIZE, Normally, 2KPageNand=0x20000, 512PageNand=0x4000, SPI=0x10000 */
		EMBMEM_BLK_SIZE = "0x20000";

		/**
		 * [EMBMEM]
		 * EMBMEM_NONE
		 * EMBMEM_NAND
		 * EMBMEM_SPI_NOR
		 * EMBMEM_SPI_NAND
		 * EMBMEM_EMMC
		 */
		EMBMEM = "EMBMEM_SPI_NAND";

		/**
		 * [FW_TYPE]
		 * FW_TYPE_NORMAL
		 * FW_TYPE_COMPRESS
		 * FW_TYPE_PARTIAL
		 * FW_TYPE_PARTIAL_COMPRESS
		 * FW_TYPE_LZMA
		 */
		FW_TYPE = "FW_TYPE_NORMAL";

		/**
		 * [LCD1]
		 * disp_off
		 * disp_if8b_lcd1_wm08001_sn75lvds83b
		 * disp_if8b_lcd1_aucn01
		 * disp_ifdsi_lcd1_nt35510
		 * disp_if8b_lcd1_pw35p00
		 * disp_if8b_lcd1_psd300_ili8961
		 * disp_ifdsi_lcd1_st7701s
		 * disp_ifdsi_lcd1_wtl096602g02_24m
		 * disp_ifdsi_lcd1_tb118
		 * disp_ifdsi_lcd1_LX118FHDB4098_OTA7290B
		 * disp_ifdsi_lcd1_sc7707_wtb112601g01_16m_z
		 * disp_ifdsi_lcd1_icnl9707_wtb112601g03_16m
		 */
		LCD1 = "disp_ifdsi_lcd1_icnl9707_wtb112601g03_16m";

		/**
		 * [SENSOR]
		 * sen_off
		 * sen_ar0237ir
		 * sen_os02k10
		 * sen_ov2715
		 * sen_ar0237
		 * sen_imx290
		 * sen_os05a10
		 * sen_imx415
		 * sen_imx335
		 */
		SENSOR1     = "sen_imx415";
		SENSOR1_CFG = "sen_imx415";
		SENSOR2     = "sen_ad_tp9950";
		SENSOR2_CFG = "Sen_off";
		SENSOR3     = "Sen_off";
		SENSOR3_CFG = "sen_off";
		/**
		 * [UI_STYLE]
		 * UI_STYLE_SPORTCAM
		 * UI_STYLE_SPORTCAM_TOUCH
		 */
		UI_STYLE = "UI_STYLE_SPORTCAM";

		/**
		 * [TSE]
		 * enable
		 * disable
		 */
		TSE = "disable";

		/**
		 * [TOUCH]
		 * TOUCH_ON
		 * TOUCH_OFF
		 */
		TOUCH = "TOUCH_ON";
		
		/**
		 * ======= Linux common =========
		 * application/external
		 */
		NVT_CFG_APP_EXTERNAL = "hostapd wireless_tool iperf-3 libiconv dosfstools";
		/* application include list */
		NVT_CFG_APP = "hfs lviewd nvtrtspd msdcnvt arm_neon_perf mem test cardv memcpy drystone-2.0";
		/* rootfs etc folder */
		NVT_ROOTFS_ETC = "CARDV_529_V70";
		/* strip executable binary and library files: yes/no */
		NVT_BINARY_FILE_STRIP = "yes";
		/* Using customized kernel config */
		NVT_CFG_KERNEL_CFG = "na51055_evb_cardv_defconfig_release";
		/* run script befor making rootfs for 'make post' */
		NVT_MAKE_POST = "make_post.sh";
		/* disable make install on sample, hdal/samples, hdal/test_cases */
		NVT_SAMPLES_INSTALL = "DISABLE";

		/**
		 * ======= Linux for different code setting =========
		 * [NVT_LINUX_SMP]
		 * NVT_LINUX_SMP_ON
		 * NVT_LINUX_SMP_OFF
		 */
		NVT_LINUX_SMP = "NVT_LINUX_SMP_ON";
		
		/**
		 * [NVT_CHIP_ID]
		 * CHIP_NA51055
		 * CHIP_NA51084
		 */
		NVT_CHIP_ID = "CHIP_NA51084";

		/**
		 * [NVT_LINUX_COMPRESS]
		 * NVT_LINUX_COMPRESS_AUTO , by linux config
		 * NVT_LINUX_COMPRESS_GZ , for rtos boot linux only
		 */
		NVT_LINUX_COMPRESS = "NVT_LINUX_COMPRESS_AUTO";

		/**
		 * [NVT_DEFAULT_NETWORK_BOOT_PROTOCOL]
		 * NVT_DEFAULT_NETWORK_BOOT_PROTOCOL_DHCP_SERVER
		 * NVT_DEFAULT_NETWORK_BOOT_PROTOCOL_DHCP_CLIENT
		 * NVT_DEFAULT_NETWORK_BOOT_PROTOCOL_STATIC_IP
		 */
		NVT_DEFAULT_NETWORK_BOOT_PROTOCOL = "NVT_DEFAULT_NETWORK_BOOT_PROTOCOL_STATIC_IP";

		/**
		 * [NVT_ROOTFS_TYPE]
		 * NVT_ROOTFS_TYPE_NAND_UBI
		 * NVT_ROOTFS_TYPE_SQUASH
		 * NVT_ROOTFS_TYPE_NAND_JFFS2
		 * NVT_ROOTFS_TYPE_NOR_JFFS2
		 * NVT_ROOTFS_TYPE_RAMDISK
		 * NVT_ROOTFS_TYPE_EXT4
		 */
		NVT_ROOTFS_TYPE = "NVT_ROOTFS_TYPE_NAND_UBI";

		/**
		 * [NVT_ROOTFS_RW_PART_EN]
		 * NVT_ROOTFS_RW_PART_EN_OFF
		 * NVT_ROOTFS_RW_PART_EN_ON
		 */
		NVT_ROOTFS_RW_PART_EN = "NVT_ROOTFS_RW_PART_EN_OFF";

		/**
		 * [NVT_ETHERNET]
		 * NVT_ETHERNET_NONE
		 * NVT_ETHERNET_EQOS
		 */
		NVT_ETHERNET = "NVT_ETHERNET_NONE";

		/**
		 * [NVT_SDIO_WIFI]: Remember to update root-fs/rootfs/etc/init.d/S05_Net
		 * NVT_SDIO_WIFI_NONE
		 * NVT_SDIO_WIFI_RTK
		 * NVT_SDIO_WIFI_BRCM
		 * NVT_SDIO_WIFI_NVT
		 */
		NVT_SDIO_WIFI = "NVT_SDIO_WIFI_NONE";

		/**
		 * [NVT_USB_WIFI]
		 * NVT_USB_WIFI_NONE
		 */
		NVT_USB_WIFI = "NVT_USB_WIFI_NONE";

		/**
		 * [NVT_USB_4G]
		 * NVT_USB_4G_NONE
		 */
		NVT_USB_4G = "NVT_USB_4G_NONE";

		/**
		 * [WIFI_RTK_MDL]  : sub item for NVT_SDIO_WIFI_RTK
		 * WIFI_RTK_MDL_NONE
		 * WIFI_RTK_MDL_8189
		 * WIFI_RTK_MDL_8189ftv
		 */
		WIFI_RTK_MDL = "WIFI_RTK_MDL_8189ftv";

		/**
		 * [WIFI_BRCM_MDL]  : sub item for NVT_SDIO_WIFI_BRCM
		 * WIFI_BRCM_MDL_43438a1_ampk6212axtal26
		 * WIFI_BRCM_MDL_43455c0_ampk6255c0
		 */
		WIFI_BRCM_MDL = "WIFI_BRCM_MDL_43438a1_ampk6212axtal26";

		/**
		 * [WIFI_NVT_MDL]  : sub item for NVT_SDIO_WIFI_NVT
		 * WIFI_NVT_MDL_18202
		 * WIFI_NVT_MDL_18211
		 */
		WIFI_NVT_MDL = "WIFI_NVT_MDL_18211";

		/**
		 * [NVT_CURL_SSL]
		 * NVT_CURL_SSL_OPENSSL
		 * NVT_CURL_SSL_WOLFSSL
		 */
		NVT_CURL_SSL = "NVT_CURL_SSL_OPENSSL";

		/**
		 * [NVT_UBOOT_ENV_IN_STORG_SUPPORT]
		 * NVT_UBOOT_ENV_IN_STORG_SUPPORT_NAND
		 * NVT_UBOOT_ENV_IN_STORG_SUPPORT_NOR
		 * NVT_UBOOT_ENV_IN_STORG_SUPPORT_MMC
		 * NVT_UBOOT_ENV_IN_STORG_SUPPORT_OFF
		 */
		NVT_UBOOT_ENV_IN_STORG_SUPPORT = "NVT_UBOOT_ENV_IN_STORG_SUPPORT_OFF";

		/**
		 * [GSENSOR]
		 * GSENSOR_OFF: "n"
		 * GSENSOR_ON : "y"
		 */
		GSENSOR_FUNC = "GSENSOR_ON";
		CONFIG_GSENSOR = "y";
		YQCONFIG_TOUCH_FUNCTION_SUPPORT = "yes";

	};
};
