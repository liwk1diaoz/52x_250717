&fastboot {
	hdal-mem {
		comn_blk_0 = <0x12975000 0x5200>;
		comn_blk_1 = <0x1297b000 0x5200>;
		comn_blk_2 = <0x12981000 0x5200>;
		comn_blk_3 = <0x12988000 0xbdda00>;
		comn_blk_4 = <0x13566000 0xbdda00>;
		comn_blk_5 = <0x14144000 0xbdda00>;
		comn_blk_6 = <0x14d22000 0xbdda00>;
		comn_blk_7 = <0x15900000 0xbdda00>;
		comn_blk_8 = <0x164de000 0xbdda00>;
		comn_blk_9 = <0x170bc000 0xbdda00>;
		comn_blk_10 = <0x17c9a000 0xbdda00>;
		comn_blk_11 = <0x18878000 0xbdda00>;
		comn_blk_12 = <0x19456000 0xbdda00>;
		comn_blk_13 = <0x1a035000 0x95300>;
		comn_blk_14 = <0x1a0cb000 0x95300>;
		comn_blk_15 = <0x1a161000 0x95300>;
		comn_blk_16 = <0x1a1f7000 0x95300>;
		comn_blk_17 = <0x1a28e000 0x54800>;
		comn_blk_18 = <0x1a2e3000 0x54800>;
		comn_blk_19 = <0x1a338000 0x54800>;
		comn_blk_20 = <0x1a38d000 0x54800>;
		comn_blk_cnt = <21>;
		vprc_ctrl_0 = <0x1a3e3000 0x85f40>;
		venc_max_0 = <0x1a46a000 0x6e7e10>;
		acap_ctrl_0 = <0x1ab53000 0x43540>;
	};
};