## BSP/linux-kernel/drivers/soc/nvt/Kconfig
```kconfig
#
# MediaTek SoC drivers
#
menu "NovaTek SoC drivers"
	depends on ARCH_NVT_IVOT_V7

config NVT_OTP_SUPPORT
	bool "NVT OTP(one time programmable) support"
	depends on ARCH_NVT_IVOT_V7
	default y
	help
	  This option will configure the NVT OTP(one time programmable) function which can be used call OTP api.

config NVT_HDAL_BUILD_IN
	bool "Novatek IVOT HDAL for Media device drivers builtin support"
	depends on ARCH_NVT_IVOT_V7
	default n
	select NVT_VOS_KWRAP
	select NVT_HDAL_KDRV_BUILTIN
	help
	  Enable this option will let vos, kdrv_builtin builtin in kernel

config NVT_HDAL_BUILD_IN_ADV
	bool "More HDAL driver builtin"
	depends on ARCH_NVT_IVOT_V7 && NVT_HDAL_BUILD_IN
	default n
	select NVT_HDAL_KDRV_COMM
	select NVT_HDAL_KDRV_GFX2D
	select NVT_HDAL_KDRV_VIDEOCAPTURE
	select NVT_HDAL_KDRV_VIDEOPROCESS
	select NVT_HDAL_KDRV_VIDEOCODEC
	select NVT_HDAL_KDRV_AUDIO_COMMON
	select NVT_HDAL_KDRV_AUDIO
	select NVT_HDAL_KFLOW_COMMON
	select NVT_HDAL_KFLOW_VIDEOCAPTURE
	select NVT_HDAL_KFLOW_VIDEOPROCESS
	select NVT_HDAL_KFLOW_VIDEOENC
	select NVT_HDAL_KFLOW_GFX2D
	select NVT_HDAL_KFLOW_VIDEOSPRITE
	select NVT_HDAL_KFLOW_AUDIOCAPTURE
	select NVT_HDAL_ISP_ISP
	select NVT_HDAL_ISP_IQ
	help
	  Enable this option will let more kdrv, kflow builtin in kernel

config NVT_HDAL_BUILD_IN_2A
	bool "2A driver builtin"
	depends on ARCH_NVT_IVOT_V7 && NVT_HDAL_BUILD_IN && NVT_HDAL_BUILD_IN_ADV
	default y
	select NVT_HDAL_ISP_AE
	select NVT_HDAL_ISP_AWB
	help
	  Enable this option to use Novatek 2A algorithm

config NVT_STACK_CHECK
	bool "NVT STACK check"
	default n
	help
	  This option will check STACK overflow issue.

config NVT_PROFILER
	bool "Novatek Profilers"
	depends on PLAT_NOVATEK
	depends on ARM || ARM64
	depends on FTRACE
	select KPROBES
	select KRETPROBES
	select EVENT_TRACING
	default n

config NVT_PERF_MEASURE
        bool "Enable nvt_perf driver for ivot Linux kernel performance measurement"
        depends on ARCH_NVT_IVOT_V7 || ARCH_NVT_IVOT_V8
        default n
        help
                Enable nvt_perf driver for ivot Linux kernel performance measurement

source "drivers/soc/nvt/nvt_hdal/Kconfig"

endmenu
```

## BSP/linux-kernel/drivers/soc/nvt/nvt_hdal/Kconfig
```kconfig
menu "Novatek HDAL Drivers"

config NVT_DMA_MONITOR
	bool "NVT dma channel monitor"
	depends on ARCH_NVT_IVOT_V7
	default y
	help
	  This option will configure dma channel monitor for debug.

config NVT_SMALL_HDAL
	bool "NVT small HDAL"
	depends on ARCH_NVT_IVOT_V7
	default n
	help
	  This option will configure fewer HDAL paths.

if NVT_HDAL_BUILD_IN
config NVT_VOS_KWRAP
        bool

config NVT_HDAL_KDRV_BUILTIN
        bool

config NVT_FAST_ISP_FLOW
	bool "NVT fast boot isp flow"
	depends on NVT_HDAL_BUILD_IN
	default y
	help
	  This option will configure fast boot isp table and flow.
endif

config NVT_HDAL_KDRV_COMM
        bool
        default n
config NVT_HDAL_KDRV_GFX2D
        bool
        default n
config NVT_HDAL_KDRV_VIDEOCAPTURE
        bool
        default n
config NVT_HDAL_KDRV_VIDEOPROCESS
        bool
        default n
config NVT_HDAL_KDRV_VIDEOCODEC
        bool
        default n
config NVT_HDAL_KDRV_AUDIO_COMMON
        bool
        default n
config NVT_HDAL_KDRV_AUDIO
        bool
        default n
config NVT_HDAL_KFLOW_COMMON
        bool
        default n
config NVT_HDAL_KFLOW_VIDEOCAPTURE
        bool
        default n
config NVT_HDAL_KFLOW_VIDEOPROCESS
        bool
        default n
config NVT_HDAL_KFLOW_VIDEOENC
        bool
        default n
config NVT_HDAL_KFLOW_GFX2D
        bool
        default n
config NVT_HDAL_KFLOW_VIDEOSPRITE
        bool
        default n
config NVT_HDAL_KFLOW_AUDIOCAPTURE
        bool
        default n
config NVT_HDAL_ISP_ISP
        bool
        default n
config NVT_HDAL_ISP_AE
        bool
        default n
config NVT_HDAL_ISP_AWB
        bool
        default n
config NVT_HDAL_ISP_IQ
        bool
        default n

endmenu
```
